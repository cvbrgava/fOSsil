// T32_1000001 Tue May 05 13:22:15 2015

 B::
 
 TOOLBAR ON
 STATUSBAR ON
 FramePOS 9.4286,6.6667,,,Maximized
 WinPAGE.RESet
 
 WinPAGE.Create P000
 
 WinCLEAR
 WinPOS 121.14 52.667 56. 16. 0. 0. W002
 Var.Local
 
 WinPOS 182.29 52.5 86. 14. 5. 0. W003
 v.f
 
 WinPOS 121.14 0.0 56. 48. 0. 0. W001
 register.view  /SL
 
 WinPOS 0.0 52.0 116. 18. 0. 0. W0002
 term.gate
 
 WinPOS 0.0 0.0 116. 46. 13. 1. W000
 WinTABS 16. 18. 25. 62.
 d.l
 
 WinPAGE.select P000
 
 ENDDO
